## sdkconfig.defaults
```kconfig
CONFIG_ESPTOOLPY_FLASHSIZE_16MB=y
CONFIG_ESPTOOLPY_FLASHSIZE="16MB"
CONFIG_PARTITION_TABLE_CUSTOM=y
CONFIG_PARTITION_TABLE_CUSTOM_FILENAME="partitions.csv"
CONFIG_PARTITION_TABLE_FILENAME="partitions.csv"

CONFIG_SPIRAM=y
CONFIG_SPIRAM_MODE_OCT=y
CONFIG_SPIRAM_SPEED_250M=y
CONFIG_SPIRAM_SPEED=250
CONFIG_SPIRAM_BOOT_INIT=y
CONFIG_SPIRAM_USE_MALLOC=y
CONFIG_SPIRAM_MALLOC_ALWAYSINTERNAL=0
CONFIG_SPIRAM_MALLOC_RESERVE_INTERNAL=81920
CONFIG_SPIRAM_TRY_ALLOCATE_WIFI_LWIP=y

CONFIG_ESP_DEFAULT_CPU_FREQ_MHZ_320=y
CONFIG_ESP_DEFAULT_CPU_FREQ_MHZ=320
CONFIG_COMPILER_OPTIMIZATION_PERF=y
CONFIG_COMPILER_OPTIMIZATION_ASSERTIONS_DISABLE=y
CONFIG_LOG_DEFAULT_LEVEL_WARN=y
CONFIG_LOG_DEFAULT_LEVEL=2
CONFIG_LOG_MAXIMUM_LEVEL=2

CONFIG_ESP_BOARD_ESP32_S31_KORVO1=y
CONFIG_ESP_BOARD_NAME="esp32_s31_korvo1"
CONFIG_ESP_BOARD_PERIPH_GPIO_SUPPORT=y
CONFIG_ESP_BOARD_PERIPH_I2C_SUPPORT=y
CONFIG_ESP_BOARD_PERIPH_I2S_SUPPORT=y
CONFIG_ESP_BOARD_DEV_AUDIO_CODEC_SUPPORT=y
CONFIG_ESP_BOARD_DEV_DISPLAY_LCD_SUPPORT=y
CONFIG_ESP_BOARD_DEV_DISPLAY_LCD_SUB_RGB_SUPPORT=y
CONFIG_ESP_BOARD_DEV_LCD_TOUCH_SUPPORT=y
CONFIG_ESP_BOARD_DEV_LCD_TOUCH_I2C_SUPPORT=y
CONFIG_ESP_BOARD_DEV_LCD_TOUCH_SUB_I2C_SUPPORT=y
CONFIG_ESP_BOARD_DEV_LED_STRIP_SUPPORT=y
CONFIG_ESP_BOARD_DEV_LED_STRIP_SUB_RMT_SUPPORT=y
CONFIG_ESP_BOARD_DEV_POWER_CTRL_SUPPORT=y
CONFIG_ESP_BOARD_DEV_POWER_CTRL_SUB_GPIO_SUPPORT=y
CONFIG_ESP_BOARD_DEV_FS_FAT_SUPPORT=y
CONFIG_ESP_BOARD_DEV_FS_FAT_SUB_SDMMC_SUPPORT=y
CONFIG_CODEC_ES8389_SUPPORT=y

CONFIG_LV_BUILD_EXAMPLES=n
# CONFIG_LV_USE_PPA is not set

CONFIG_DMA2D_OPERATION_FUNC_IN_IRAM=y
CONFIG_DMA2D_ISR_IRAM_SAFE=y

CONFIG_SPIRAM_FETCH_INSTRUCTIONS=y
CONFIG_SPIRAM_RODATA=y
CONFIG_SPIRAM_XIP_FROM_PSRAM=y
```
